
qcom,2314401_ck_m3000a_3000mah_averaged_masterslave_feb16th2016 {
	/* #2314401_CK_M3000A_3000mAh_averaged_MasterSlave_Feb16th2016*/
	qcom,max-voltage-uv = <4400000>;
	qcom,nom-batt-capacity-mah = <3000>;
	qcom,batt-id-kohm = <90>;
	qcom,battery-beta = <3435>;
	qcom,fastchg-current-ma = <1450>;
	qcom,battery-type = "2314401_ck_m3000a_3000mah_averaged_masterslave_feb16th2016";
	qcom,chg-rslow-comp-c1 = <3638801>;
	qcom,chg-rslow-comp-c2 = <6142227>;
	qcom,chg-rs-to-rslow = <887417>;
	qcom,chg-rslow-comp-thr = <0xB4>;
	qcom,checksum = <0x7CE0>;
	qcom,gui-version = "PMI8950GUI - 2.0.0.15";
	qcom,fg-profile-data = [
		 EF 83 52 7D 
		 70 81 D8 77 
		 62 83 6D 6E 
		 5A 88 D6 8E 
		 1C 82 F9 99 
		 C7 BC 2F C9 
		 5A 0F F0 83 
		 EA 7C 03 81 
		 DE 76 60 83 
		 19 5D 8B 83 
		 6B 8F 51 82 
		 97 99 DC BC 
		 B4 C9 54 0E 
		 F7 0B 92 5A 
		 14 70 B2 FD 
		 A6 3E B1 3E 
		 07 39 00 00 
		 F3 3F 62 2B 
		 96 3C 00 00 
		 00 00 00 00 
		 00 00 00 00 
		 00 6B 20 6A 
		 D3 58 63 81 
		 FF 74 B4 63 
		 C0 64 E5 79 
		 9D 74 1D 63 
		 B2 7C 86 C1 
		 0C BB 62 C2 
		 64 A0 71 0C 
		 28 00 FF 36 
		 F0 11 30 03 
		 00 00 00 0C 
	];
};
